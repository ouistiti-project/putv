## packages/buildroot/Config.in
```kconfig
source "$BR2_EXTERNAL_PUTV_PATH/package/putv/Config.in"
source "$BR2_EXTERNAL_PUTV_PATH/package/tinysvcmdns/Config.in"
```

## packages/buildroot/package/putv/Config.in
```kconfig
menu "Putv"

config BR2_PACKAGE_PUTV
	bool "putv: Embedded media streamer"
	select BR2_PACKAGE_LIBMAD
	select BR2_PACKAGE_JANSSON
	select BR2_PACKAGE_SQLITE
	select BR2_PACKAGE_LIBID3TAG
	select BR2_PACKAGE_ALSA_LIB
	select BR2_PACKAGE_LAME
	select BR2_PACKAGE_FLAC
	select BR2_PACKAGE_LIBCURL
	help
	  https://github.com/ouistiti-project

config BR2_PACKAGE_PUTV_DEFCONFIG
	string "defconfig"
	depends on BR2_PACKAGE_PUTV
	default "ouiradio_defconfig"

config BR2_PACKAGE_PUTV_WEBIF_HTTPS
	bool "install web interface on HTTPS"
	depends on BR2_PACKAGE_PUTV

config BR2_PACKAGE_PUTV_UPNPRENDERER
	bool "Enable Upnp renderer"
	select BR2_PACKAGE_GMRENDER_RESURRECT2
	depends on BR2_PACKAGE_PUTV

endmenu
```

## packages/buildroot/package/tinysvcmdns/Config.in
```kconfig
config BR2_PACKAGE_TINYSVCMDNS
	bool "tinysvcmdns: Embedded dns-ds server"
	help
	  https://github.com/ouistiti-project
```
